AUTOSAR XML (schema 4.0)
package /DiagnosticExtract
  diagnostic event Ev_MisfireCyl1_P0301: uds-dtc-value=P0301
  diagnostic event Ev_LostCommECM_U0100: uds-dtc-value=U0100
  diagnostic event Ev_WheelSpeedLF_C0035: uds-dtc-value=C0035
  diagnostic trouble code Dtc_BatteryLow: uds-dtc-value=B1234
  diagnostic service ReadDtcInformation_0x19
  diagnostic service ClearDiagnosticInformation_0x14
  diagnostic service DiagnosticSessionControl_0x10
